## drivers/input/button/Kconfig
```kconfig
menuconfig RP_BUTTON
	bool "rongpin button"
	help
	  Say Y here, and a list of supported button will be displayed.
	  This option doesn't affect the kernel.
		If unsure, say Y.

if RP_BUTTON
config RONGPIN_BUTTON
	tristate "rongpin button"
	default y
	---help---
	  Say Y here if you want to support rongpin button.
endif
```

## drivers/input/g-sensor/Kconfig
```kconfig
menuconfig RP_G_SENSOR
	bool "rongpin g-sensor"
	help
	  Say Y here, and a list of supported g-sensor will be displayed.
	  This option doesn't affect the kernel.
		If unsure, say Y.
	  
if RP_G_SENSOR

config RONGPIN_GSENEOR_MMA7660
	tristate "rongpin g-sensor mma7660"
	default y
	---help---
	  Say Y here if you want to support rongpin 3-Axis G sensor.

endif
```

## drivers/rongpin/Kconfig
```kconfig
menu "rongpin customized drivers"

	  
choice
prompt "rpdzkj project select"
default BOARD


config BOARD
	bool "BOARD"
	---help---
	  select BOARD


config RP119
	bool "RP119"
	---help---
	  select rp119
	  	  
config RP7
	bool "RP7"
	---help---
	  select rp7



endchoice	

config RPDZKJ_SYSFS
	tristate "rpdzkj sysfs  support"
	default y
	help
	  Generic rpdzkj power off .
  

endmenu
```

## drivers/switch/Kconfig
```kconfig
menuconfig SWITCH
	tristate "Switch class support"
	help
	  Say Y here to enable switch class support. This allows
	  monitoring switches by userspace via sysfs and uevent.

if SWITCH

config SWITCH_GPIO
	tristate "GPIO Swith support"
	depends on GENERIC_GPIO
	help
	  Say Y here to enable GPIO based switch support.

config SWITCH_4212_HEADSET
	bool "4212 Headset Detect"
	depends on SWITCH_GPIO 

endif # SWITCH
```
